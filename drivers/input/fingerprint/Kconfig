## drivers/input/fingerprint/Kconfig
```kconfig
#
# Fingerprint driver configuration
#

if MACH_ASUS_SDM660

menuconfig INPUT_FINGERPRINT
	bool "Fingerprint"
	help
	  Say Y here, and a list of supported fingerprint will be displayed.
	  This option doesn't affect the kernel.

	  If unsure, say Y.

if INPUT_FINGERPRINT

source "drivers/input/fingerprint/cdfingerfp/Kconfig"

source "drivers/input/fingerprint/focaltech/Kconfig"

source "drivers/input/fingerprint/goodix/Kconfig"

endif

endif
```

## drivers/input/fingerprint/goodix/Kconfig
```kconfig
config GOODIX_FINGERPRINT
	depends on MACH_ASUS_X00TD
	tristate "generic goodix fingerprint driver"
	default y
	help
	add support for goodix fingerprint driver.
```

## drivers/input/touchscreen/nt36xxx_ASUS/Kconfig
```kconfig
# SPDX-License-Identifier: GPL-2.0-only
#
# Novatek NT36xxx touchscreen driver configuration
#
config TOUCHSCREEN_NT36XXX_ASUS
	bool "ASUS X00TD/X01BD common Novatek NT36XXX driver"
	depends on !TOUCHSCREEN_NT36XXX_X01BD
	depends on !TOUCHSCREEN_NT36XXX_X00TD
	help
	  Say Y here if you have a Novatek NT36xxx touchscreen connected
	  to your system.

	  If unsure, say N.
```

## drivers/input/touchscreen/nt36xxx_X00TD/Kconfig
```kconfig
#
# Novatek NT36xxx touchscreen driver configuration
#
config TOUCHSCREEN_NT36XXX_X00TD
	bool "ASUS X00TD Novatek NT36XXX driver"
	default n
	help
	  Say Y here if you have a Novatek NT36xxx touchscreen connected
	  to your system.

	  If unsure, say N.
```

## drivers/input/touchscreen/nt36xxx_X01BD/Kconfig
```kconfig
#
# Novatek NT36xxx touchscreen driver configuration
#
config TOUCHSCREEN_NT36XXX_X01BD
	bool "ASUS X01BD Novatek NT36XXX driver"
	default n
	help
	  Say Y here if you have a Novatek NT36xxx touchscreen connected
	  to your system.

	  If unsure, say N.
```
